## extra-modules/hfxo-always-on/Kconfig
```kconfig
config KB_HFXO_ALWAYS_ON
    bool "Keep the 32 MHz crystal (HFXO) running"
    depends on CLOCK_CONTROL_NRF
    help
      Hold a permanent request on the nRF high-frequency clock so the 32 MHz
      crystal never stops. The ESB TDMA stack switches HFXO off between slots
      and turns it back on only ~366 us before the next RX window (Nordic's own
      MPSL budgets 1400 us), so a slow crystal can miss slots and skew the drift
      estimate, which desyncs the half. Costs roughly 0.25 mA while awake; the
      clock stops anyway when the half enters deep sleep.
```

## extra-modules/zmk-split-esb/src/radio/Kconfig
```kconfig
#
# Copyright (c) 2018 Nordic Semiconductor ASA
#
# SPDX-License-Identifier: LicenseRef-Nordic-5-Clause
#

# Radio layer options. Sourced from the module Kconfig inside "if ZMK_SPLIT_ESB".

config ZMK_ESB_CENTRAL
	bool "esb tdma central config"
	default n

config ZMK_ESB_MAX_PAYLOAD_LENGTH
	int "Maximum payload size"
	default 20
	range 1 252
	help
	  The maximum size of the payload.

config ZMK_ESB_RX_FIFO_SIZE
	int "RX buffer length"
	default 8
	help
	  The length of the RX FIFO buffer, in number of elements.

config ZMK_ESB_PIPE_COUNT
	int "Maximum number of pipes"
	default 8
	range 1 8
	help
	  The maximum number of pipes allowed in the API. Can be used if you
	  need to restrict the number of pipes used. The purpose is to prevent
	  accidental use of additional pipes, but it's not a problem leaving
	  this at 8 even if fewer pipes are used.

config ZMK_ESB_RADIO_IRQ_PRIORITY
	int "Radio interrupt priority"
	range 0 5 if ZERO_LATENCY_IRQS
	range 0 6
	default 1

config ZMK_ESB_EVENT_IRQ_PRIORITY
	int "Event interrupt priority"
	range 0 5 if ZERO_LATENCY_IRQS
	range 0 6
	default 2

config ZMK_ESB_SIM_ISR_LATENCY_US
	int "Simulated interrupt latency (tests/esb only)"
	depends on ARCH_POSIX
	default 0
	help
	  On the simulated board code runs in zero time, so an interrupt handler
	  reacts in the same microsecond the interrupt is raised. A real CPU
	  needs some tens of microseconds to get there and through the handler.
	  This makes every radio-layer interrupt handler start that much later,
	  so the tests also cover the time the handlers have.

config ZMK_ESB_TX_RINGBUF_SIZE
	int "set tx ringbuf size"
	default 256

config ZMK_ESB_WHITEEN
	bool "enable data whitening"
	default y

choice ZMK_ESB_POLLING_RATE_SEL
    prompt "Polling rate"
    default ZMK_ESB_POLLING_RATE_1KHZ

config ZMK_ESB_POLLING_RATE_2KHZ
    bool "2000 Hz"

config ZMK_ESB_POLLING_RATE_1KHZ
    bool "1000 Hz"

config ZMK_ESB_POLLING_RATE_500HZ
    bool "500 Hz"

config ZMK_ESB_POLLING_RATE_250HZ
    bool "250 Hz"

config ZMK_ESB_POLLING_RATE_125HZ
    bool "125 Hz"

endchoice

config ZMK_ESB_POLLING_RATE
    int
    default 2000 if ZMK_ESB_POLLING_RATE_2KHZ
    default 1000 if ZMK_ESB_POLLING_RATE_1KHZ
    default 500  if ZMK_ESB_POLLING_RATE_500HZ
    default 250  if ZMK_ESB_POLLING_RATE_250HZ
    default 125  if ZMK_ESB_POLLING_RATE_125HZ

menu "Hardware selection (alter with care)"

choice ZMK_ESB_SYS_TIMER
	default ZMK_ESB_SYS_TIMER021 if $(dt_nodelabel_has_compat,timer021,$(DT_COMPAT_NORDIC_NRF_TIMER))
	default ZMK_ESB_SYS_TIMER10 if $(dt_nodelabel_has_compat,timer10,$(DT_COMPAT_NORDIC_NRF_TIMER))
	default ZMK_ESB_SYS_TIMER2
	prompt "Timer to use for the ESB system timer"

config ZMK_ESB_SYS_TIMER0
	bool "TIMER0"
	depends on $(dt_nodelabel_has_compat,timer0,$(DT_COMPAT_NORDIC_NRF_TIMER))
	select NRFX_TIMER0

config ZMK_ESB_SYS_TIMER1
	bool "TIMER1"
	depends on $(dt_nodelabel_has_compat,timer1,$(DT_COMPAT_NORDIC_NRF_TIMER))
	select NRFX_TIMER1

config ZMK_ESB_SYS_TIMER2
	bool "TIMER2"
	depends on $(dt_nodelabel_has_compat,timer2,$(DT_COMPAT_NORDIC_NRF_TIMER))
	select NRFX_TIMER2

config ZMK_ESB_SYS_TIMER3
	bool "TIMER3"
	depends on $(dt_nodelabel_has_compat,timer3,$(DT_COMPAT_NORDIC_NRF_TIMER))
	select NRFX_TIMER3

config ZMK_ESB_SYS_TIMER4
	bool "TIMER4"
	depends on $(dt_nodelabel_has_compat,timer4,$(DT_COMPAT_NORDIC_NRF_TIMER))
	select NRFX_TIMER4

config ZMK_ESB_SYS_TIMER10
	bool "TIMER10"
	depends on $(dt_nodelabel_has_compat,timer10,$(DT_COMPAT_NORDIC_NRF_TIMER))
	select NRFX_TIMER10

config ZMK_ESB_SYS_TIMER020
	bool "TIMER020"
	depends on $(dt_nodelabel_has_compat,timer020,$(DT_COMPAT_NORDIC_NRF_TIMER))
	select NRFX_TIMER020

config ZMK_ESB_SYS_TIMER021
	bool "TIMER021"
	depends on $(dt_nodelabel_has_compat,timer021,$(DT_COMPAT_NORDIC_NRF_TIMER))
	select NRFX_TIMER021

config ZMK_ESB_SYS_TIMER022
	bool "TIMER022"
	depends on $(dt_nodelabel_has_compat,timer022,$(DT_COMPAT_NORDIC_NRF_TIMER))
	select NRFX_TIMER022

endchoice

config ZMK_ESB_SYS_TIMER_INSTANCE
	int
	default 0 if ZMK_ESB_SYS_TIMER0
	default 1 if ZMK_ESB_SYS_TIMER1
	default 2 if ZMK_ESB_SYS_TIMER2
	default 3 if ZMK_ESB_SYS_TIMER3
	default 4 if ZMK_ESB_SYS_TIMER4
	default 10 if ZMK_ESB_SYS_TIMER10
	default 20 if ZMK_ESB_SYS_TIMER020
	default 21 if ZMK_ESB_SYS_TIMER021
	default 22 if ZMK_ESB_SYS_TIMER022

config ZMK_ESB_SYS_TIMER_INSTANCE_LEADING_ZERO
	bool
	default y if ZMK_ESB_SYS_TIMER020 || ZMK_ESB_SYS_TIMER021 || ZMK_ESB_SYS_TIMER022

choice ZMK_ESB_SYS_RTC
	default ZMK_ESB_SYS_RTC2 if $(dt_nodelabel_has_compat,rtc2,$(DT_COMPAT_NORDIC_NRF_RTC))
	default ZMK_ESB_SYS_RTC0
	prompt "RTC to use for the ESB system RTC"

config ZMK_ESB_SYS_RTC0
	bool "RTC0"
	depends on $(dt_nodelabel_has_compat,rtc0,$(DT_COMPAT_NORDIC_NRF_RTC))
	select NRFX_RTC0

config ZMK_ESB_SYS_RTC1
	bool "RTC1"
	depends on $(dt_nodelabel_has_compat,rtc1,$(DT_COMPAT_NORDIC_NRF_RTC))
	select NRFX_RTC1

config ZMK_ESB_SYS_RTC2
	bool "RTC2"
	depends on $(dt_nodelabel_has_compat,rtc2,$(DT_COMPAT_NORDIC_NRF_RTC))
	select NRFX_RTC2
	
endchoice
config ZMK_ESB_SYS_RTC_INSTANCE
	int
	default 0 if ZMK_ESB_SYS_RTC0
	default 1 if ZMK_ESB_SYS_RTC1
	default 2 if ZMK_ESB_SYS_RTC2

endmenu

config ZMK_ESB_HFCLK_OFF_EVERY_TX
	bool "turn off hfclk after every tx to reduce power consumption"
	default n

config ZMK_ESB_FAST_SWITCHING_PERIPHERAL
	bool "peripheral fast switching between rx/tx"
	default n

config ZMK_ESB_DISABLE_IRQ_TX
	bool "disable tx event irq"
	default n

config ZMK_ESB_DYNAMIC_INTERRUPTS
	bool "Use direct dynamic interrupts"
	select DYNAMIC_INTERRUPTS
	select DYNAMIC_DIRECT_INTERRUPTS
	help
	  This option configures ESB IRQ handlers using direct dynamic
	  interrupts. This allows reconfiguring ZMK_ESB_SYS_TIMER_IRQn, ZMK_ESB_EVT_IRQ,
	  and RADIO_IRQn handlers during runtime when ESB is uninitialized.

config ZMK_ESB_NEVER_DISABLE_TX
	select EXPERIMENTAL
	bool "Never disable radio transmission stage"
	help
	  This option changes the radio behavior so that the
	  transmitter remains IDLE between transmissions instead of being disabled.
	  This is applicable only when the packet is not acknowledged. Otherwise,
	  the radio emitter needs to be turned off to enable the radio receiver.
	  This reduces delay between consecutive transmissions but consumes more energy.

config ZMK_ESB_FAST_SWITCHING
	select EXPERIMENTAL
	depends on !ZMK_ESB_NEVER_DISABLE_TX && (SOC_NRF54H20_CPURAD)
	bool "Fast radio TX/RX and RX/TX switching [EXPERIMENTAL]"
	help
	  This option enables fast switching between transmit (TX) and receive (RX) modes
	  and vice versa for ESB configurations.
	  For the PTX node, this switching occurs after transmitting a packet and before waiting
	  for acknowledgment (TX -> RX).
	  For the PRX node, this switching occurs after receiving a packet and before
	  transmitting an acknowledgment (RX -> TX).
	  Enabling this feature can improve the responsiveness and efficiency of the radio
	  communication system by reducing the latency.

config ZMK_ESB_FAST_CHANNEL_SWITCHING
	select EXPERIMENTAL
	depends on SOC_NRF54H20_CPURAD
	bool "Fast radio channel switching [EXPERIMENTAL]"
	help
	  This option enables fast radio channel switching.
	  Allows the radio channel to be changed in RX radio state
	  without the need to switch the radio to DISABLE state.

module=ZMK_ESB
module-str=ZMK_ESB
source "${ZEPHYR_BASE}/subsys/logging/Kconfig.template.log_config"
```

## extra-modules/zmk-split-esb/src/transport/Kconfig
```kconfig
# Copyright (c) 2025 The ZMK Contributors
# SPDX-License-Identifier: MIT

if ZMK_SPLIT && ZMK_SPLIT_ESB

menu "ESB Transport"

config ZMK_SPLIT_ESB_ROLE_CENTRAL
    bool
    default y if ZMK_SPLIT_ROLE_CENTRAL
    select ZMK_ESB_CENTRAL

config ZMK_SPLIT_ESB_PRIORITY
    int "ESB transport priority"
    default 1
    help
        Lower number priority transports are favored over higher numbers.
        ZMK_SPLIT_TRANSPORT_{CENTRAL,PERIPHERAL}_REGISTER already referenced
        this symbol; without a definition the registration section was named
        after the literal macro text rather than a priority.

endmenu

config ZMK_SPLIT_ESB_PERIPHERAL_ID
    int "Default peripheral id for TX"
    default 0

config ZMK_SPLIT_ESB_BITRATE_2MBPS
    bool "Set ESB bitrate to 2Mbps"
    default y

config ZMK_SPLIT_ESB_USE_WORK_QUEUE_DEDICATED
    bool "use dedicated workqueue for esb thread"
    default n

config ZMK_SPLIT_ESB_RX_THREAD_STACK_SIZE
    int "esb rx thread stack size"
    default 2048

config ZMK_SPLIT_ESB_RX_THREAD_PRIORITY
    int "esb rx thread priority"
    default -1

config ZMK_SPLIT_ESB_SEND_WHOLE_KEY
    bool "send whole key state"
    default n

config ZMK_SPLIT_ESB_PACED_SOURCE
    int "Half whose key events the central passes on in a fixed rhythm (-1: none)"
    depends on ZMK_SPLIT_ESB_ROLE_CENTRAL && ZMK_SPLIT_ESB_SEND_WHOLE_KEY
    default -1
    help
        Makes the timing between the two halves what it is over Bluetooth.

        With a Bluetooth split, the half that is the central handles its own
        keys at once, while the other half's keys wait for the next connection
        event, which comes every 7.5 ms. Over ESB both halves arrive within a
        millisecond or three. That is faster, but it moves the point at which
        a hold-tap on one half and a key on the other count as "released
        first": a thumb released up to ~7 ms after a key of the other hand
        was a tap over Bluetooth and is a hold over ESB, and typing habits are
        tuned to the former.

        With this set to a half's peripheral id (0: left, 1: right), the
        central passes that half's key events on only at multiples of
        ZMK_SPLIT_ESB_PACED_INTERVAL_US, like a connection event would. Set it
        to the half that is not the central in the Bluetooth mode the keymap
        was tuned in. It adds up to one interval of latency to that half.

config ZMK_SPLIT_ESB_PACED_INTERVAL_US
    int "Rhythm of the paced half, in microseconds"
    depends on ZMK_SPLIT_ESB_PACED_SOURCE >= 0
    default 7500
    help
        7500 is the connection interval ZMK uses between the halves.

config ZMK_SPLIT_ESB_LINK_STATS
    bool "Log link statistics once per second"
    depends on ZMK_SPLIT_ESB_ROLE_CENTRAL
    help
        The central logs, for every half, how the link did in the last second
        (answers, retries, lost sync, signal strength, and how long the half's
        key events waited before they were acknowledged) and every key event
        as it arrives. Needs a log backend, e.g. the zmk-usb-logging snippet.
        See the module README for how to read the lines.

module = ZMK_SPLIT_ESB
module-str = ZMK_SPLIT_ESB
source "${ZEPHYR_BASE}/subsys/logging/Kconfig.template.log_config"

endif #ZMK_SPLIT && ZMK_SPLIT_ESB

# **************************************************************************
# Following config is cloned for battery monitoring, if BLE is not enabled.
# **************************************************************************

if ZMK_SPLIT && !ZMK_SPLIT_BLE
if ZMK_SPLIT_ROLE_CENTRAL

config ZMK_SPLIT_BLE_CENTRAL_PERIPHERALS
    int "Number of peripherals that will connect to the central."

config ZMK_SPLIT_BLE_CENTRAL_BATTERY_LEVEL_FETCHING
    bool "Fetch Peripheral Battery Level Info"

if ZMK_SPLIT_BLE_CENTRAL_BATTERY_LEVEL_FETCHING

config ZMK_SPLIT_BLE_CENTRAL_BATTERY_LEVEL_QUEUE_SIZE
    int "Max number of battery level events to queue when received from peripherals"
    default ZMK_SPLIT_BLE_CENTRAL_PERIPHERALS

config ZMK_SPLIT_BLE_CENTRAL_BATTERY_LEVEL_PROXY
    bool "Proxy Peripheral Battery Level Info"

endif #ZMK_SPLIT_BLE_CENTRAL_BATTERY_LEVEL_FETCHING

endif #ZMK_SPLIT_ROLE_CENTRAL
endif #ZMK_SPLIT && !ZMK_SPLIT_BLE
```
